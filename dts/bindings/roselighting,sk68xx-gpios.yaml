## dts/bindings/roselighting,sk68xx-gpios.yaml
```yaml
# Copyright (c) 2025 James Wu <jameswu62@yahoo.co.nz>
# SPDX-License-Identifier: Apache-2.0

compatible: "roselighting,sk68xx"
description: SK68XX RGB LED
include: [led-strip.yaml]

properties:
  gpios:
    required: true
    type: phandle-array
    description: |
      GPIO to send command data to the controller.

      
```

## dts/bindings/roselighting,sk68xxminihs-gpios.yaml
```yaml
# Copyright (c) 2025 James Wu <jameswu62@yahoo.co.nz>
# SPDX-License-Identifier: Apache-2.0

compatible: "roselighting,sk68xxminihs"
description: SK68XXMINI-HS RGB LED
include: [led-strip.yaml]

properties:
  gpios:
    required: true
    type: phandle-array
    description: |
      GPIO to send command data to the controller.

      
```
